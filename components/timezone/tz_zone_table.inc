/*
 * GENERATED FILE -- DO NOT EDIT BY HAND.
 * Regenerate with `python tools/gen_tz_table.py` (that script documents why
 * this table is generated and what the POSIX rules mean).
 *
 * Source: IANA tzdata 2026c (the POSIX TZ footer of each compiled TZif).
 * 598 zone names -- canonical names plus their historical aliases, so a
 * host reporting "Asia/Calcutta" or "US/Pacific" is accepted as-is -- sharing
 * 94 distinct POSIX rules.
 *
 * Transition times were clamped into the POSIX.1 00:00..24:00 range for 8 zone(s):
 *   America/Godthab
 *   America/Nuuk
 *   America/Scoresbysund
 *   Asia/Gaza
 *   Asia/Hebron
 *   Asia/Jerusalem
 *   Asia/Tel_Aviv
 *   Israel
 * Those stay DST-correct except within a day or so of a transition; see
 * tools/gen_tz_table.py (CLAMPING) for why that beats letting newlib reject
 * the rule and drop DST for the whole year.
 */

#define TZ_TABLE_TZDATA_VERSION "2026c"
#define TZ_TABLE_RULE_COUNT 94
#define TZ_TABLE_ZONE_COUNT 598

/* Distinct POSIX TZ rules, handed to setenv("TZ", ...) verbatim. */
static const char *const k_tz_rules[TZ_TABLE_RULE_COUNT] = {
    "<+00>0",
    "<+00>0<+02>-2,M3.5.0/1,M10.5.0/3",
    "<+01>-1",
    "<+02>-2",
    "<+0330>-3:30",
    "<+03>-3",
    "<+0430>-4:30",
    "<+04>-4",
    "<+0530>-5:30",
    "<+0545>-5:45",
    "<+05>-5",
    "<+0630>-6:30",
    "<+06>-6",
    "<+07>-7",
    "<+0845>-8:45",
    "<+08>-8",
    "<+09>-9",
    "<+1030>-10:30<+11>-11,M10.1.0,M4.1.0",
    "<+10>-10",
    "<+11>-11",
    "<+11>-11<+12>,M10.1.0,M4.1.0/3",
    "<+1245>-12:45<+1345>,M9.5.0/2:45,M4.1.0/3:45",
    "<+12>-12",
    "<+13>-13",
    "<+14>-14",
    "<-00>0",
    "<-01>1",
    "<-01>1<+00>,M3.5.0/0,M10.5.0/1",
    "<-02>2",
    "<-02>2<-01>,M3.5.0/0,M10.5.0/0",
    "<-03>3",
    "<-03>3<-02>,M3.2.0,M11.1.0",
    "<-04>4",
    "<-04>4<-03>,M9.1.6/24,M4.1.6/24",
    "<-05>5",
    "<-06>6",
    "<-06>6<-05>,M9.1.6/22,M4.1.6/22",
    "<-07>7",
    "<-08>8",
    "<-0930>9:30",
    "<-09>9",
    "<-10>10",
    "<-11>11",
    "<-12>12",
    "ACST-9:30",
    "ACST-9:30ACDT,M10.1.0,M4.1.0/3",
    "AEST-10",
    "AEST-10AEDT,M10.1.0,M4.1.0/3",
    "AKST9AKDT,M3.2.0,M11.1.0",
    "AST4",
    "AST4ADT,M3.2.0,M11.1.0",
    "AWST-8",
    "CAT-2",
    "CET-1",
    "CET-1CEST,M3.5.0,M10.5.0/3",
    "CST-8",
    "CST5CDT,M3.2.0/0,M11.1.0/1",
    "CST6",
    "CST6CDT,M3.2.0,M11.1.0",
    "ChST-10",
    "EAT-3",
    "EET-2",
    "EET-2EEST,M3.4.4/24,M10.4.4/24",
    "EET-2EEST,M3.5.0/0,M10.5.0/0",
    "EET-2EEST,M3.5.0/3,M10.5.0/4",
    "EET-2EEST,M4.5.5/0,M10.5.4/24",
    "EST5",
    "EST5EDT,M3.2.0,M11.1.0",
    "GMT0",
    "GMT0BST,M3.5.0/1,M10.5.0",
    "HKT-8",
    "HST10",
    "HST10HDT,M3.2.0,M11.1.0",
    "IST-1GMT0,M10.5.0,M3.5.0/1",
    "IST-2IDT,M3.4.4/24,M10.5.0",
    "IST-5:30",
    "JST-9",
    "KST-9",
    "MSK-3",
    "MST7",
    "MST7MDT,M3.2.0,M11.1.0",
    "NST3:30NDT,M3.2.0,M11.1.0",
    "NZST-12NZDT,M9.5.0,M4.1.0/3",
    "PKT-5",
    "PST-8",
    "PST8PDT,M3.2.0,M11.1.0",
    "SAST-2",
    "SST11",
    "UTC0",
    "WAT-1",
    "WET0WEST,M3.5.0/1,M10.5.0",
    "WIB-7",
    "WIT-9",
    "WITA-8",
};

/* One entry per accepted IANA name, sorted bytewise for binary search.
 * fallback_min is the offset (minutes east of UTC) that zone spends most of
 * the year on -- the fixed offset timezone.c schedules on if libc ever
 * refuses the rule. Sampled from tzdata across 2026. */
typedef struct {
    const char *iana;
    uint16_t    rule;            /* index into k_tz_rules */
    int16_t     fallback_min;
} tz_zone_t;

static const tz_zone_t k_tz_zones[TZ_TABLE_ZONE_COUNT] = {
    { "Africa/Abidjan",                    68,     0 },
    { "Africa/Accra",                      68,     0 },
    { "Africa/Addis_Ababa",                60,   180 },
    { "Africa/Algiers",                    53,    60 },
    { "Africa/Asmara",                     60,   180 },
    { "Africa/Asmera",                     60,   180 },
    { "Africa/Bamako",                     68,     0 },
    { "Africa/Bangui",                     89,    60 },
    { "Africa/Banjul",                     68,     0 },
    { "Africa/Bissau",                     68,     0 },
    { "Africa/Blantyre",                   52,   120 },
    { "Africa/Brazzaville",                89,    60 },
    { "Africa/Bujumbura",                  52,   120 },
    { "Africa/Cairo",                      65,   120 },
    { "Africa/Casablanca",                  0,    60 },
    { "Africa/Ceuta",                      54,   120 },
    { "Africa/Conakry",                    68,     0 },
    { "Africa/Dakar",                      68,     0 },
    { "Africa/Dar_es_Salaam",              60,   180 },
    { "Africa/Djibouti",                   60,   180 },
    { "Africa/Douala",                     89,    60 },
    { "Africa/El_Aaiun",                    0,    60 },
    { "Africa/Freetown",                   68,     0 },
    { "Africa/Gaborone",                   52,   120 },
    { "Africa/Harare",                     52,   120 },
    { "Africa/Johannesburg",               86,   120 },
    { "Africa/Juba",                       52,   120 },
    { "Africa/Kampala",                    60,   180 },
    { "Africa/Khartoum",                   52,   120 },
    { "Africa/Kigali",                     52,   120 },
    { "Africa/Kinshasa",                   89,    60 },
    { "Africa/Lagos",                      89,    60 },
    { "Africa/Libreville",                 89,    60 },
    { "Africa/Lome",                       68,     0 },
    { "Africa/Luanda",                     89,    60 },
    { "Africa/Lubumbashi",                 52,   120 },
    { "Africa/Lusaka",                     52,   120 },
    { "Africa/Malabo",                     89,    60 },
    { "Africa/Maputo",                     52,   120 },
    { "Africa/Maseru",                     86,   120 },
    { "Africa/Mbabane",                    86,   120 },
    { "Africa/Mogadishu",                  60,   180 },
    { "Africa/Monrovia",                   68,     0 },
    { "Africa/Nairobi",                    60,   180 },
    { "Africa/Ndjamena",                   89,    60 },
    { "Africa/Niamey",                     89,    60 },
    { "Africa/Nouakchott",                 68,     0 },
    { "Africa/Ouagadougou",                68,     0 },
    { "Africa/Porto-Novo",                 89,    60 },
    { "Africa/Sao_Tome",                   68,     0 },
    { "Africa/Timbuktu",                   68,     0 },
    { "Africa/Tripoli",                    61,   120 },
    { "Africa/Tunis",                      53,    60 },
    { "Africa/Windhoek",                   52,   120 },
    { "America/Adak",                      72,  -540 },
    { "America/Anchorage",                 48,  -480 },
    { "America/Anguilla",                  49,  -240 },
    { "America/Antigua",                   49,  -240 },
    { "America/Araguaina",                 30,  -180 },
    { "America/Argentina/Buenos_Aires",    30,  -180 },
    { "America/Argentina/Catamarca",       30,  -180 },
    { "America/Argentina/ComodRivadavia",  30,  -180 },
    { "America/Argentina/Cordoba",         30,  -180 },
    { "America/Argentina/Jujuy",           30,  -180 },
    { "America/Argentina/La_Rioja",        30,  -180 },
    { "America/Argentina/Mendoza",         30,  -180 },
    { "America/Argentina/Rio_Gallegos",    30,  -180 },
    { "America/Argentina/Salta",           30,  -180 },
    { "America/Argentina/San_Juan",        30,  -180 },
    { "America/Argentina/San_Luis",        30,  -180 },
    { "America/Argentina/Tucuman",         30,  -180 },
    { "America/Argentina/Ushuaia",         30,  -180 },
    { "America/Aruba",                     49,  -240 },
    { "America/Asuncion",                  30,  -180 },
    { "America/Atikokan",                  66,  -300 },
    { "America/Atka",                      72,  -540 },
    { "America/Bahia",                     30,  -180 },
    { "America/Bahia_Banderas",            57,  -360 },
    { "America/Barbados",                  49,  -240 },
    { "America/Belem",                     30,  -180 },
    { "America/Belize",                    57,  -360 },
    { "America/Blanc-Sablon",              49,  -240 },
    { "America/Boa_Vista",                 32,  -240 },
    { "America/Bogota",                    34,  -300 },
    { "America/Boise",                     80,  -360 },
    { "America/Buenos_Aires",              30,  -180 },
    { "America/Cambridge_Bay",             80,  -360 },
    { "America/Campo_Grande",              32,  -240 },
    { "America/Cancun",                    66,  -300 },
    { "America/Caracas",                   32,  -240 },
    { "America/Catamarca",                 30,  -180 },
    { "America/Cayenne",                   30,  -180 },
    { "America/Cayman",                    66,  -300 },
    { "America/Chicago",                   58,  -300 },
    { "America/Chihuahua",                 57,  -360 },
    { "America/Ciudad_Juarez",             80,  -360 },
    { "America/Coral_Harbour",             66,  -300 },
    { "America/Cordoba",                   30,  -180 },
    { "America/Costa_Rica",                57,  -360 },
    { "America/Coyhaique",                 30,  -180 },
    { "America/Creston",                   79,  -420 },
    { "America/Cuiaba",                    32,  -240 },
    { "America/Curacao",                   49,  -240 },
    { "America/Danmarkshavn",              68,     0 },
    { "America/Dawson",                    79,  -420 },
    { "America/Dawson_Creek",              79,  -420 },
    { "America/Denver",                    80,  -360 },
    { "America/Detroit",                   67,  -240 },
    { "America/Dominica",                  49,  -240 },
    { "America/Edmonton",                  57,  -360 },
    { "America/Eirunepe",                  34,  -300 },
    { "America/El_Salvador",               57,  -360 },
    { "America/Ensenada",                  85,  -420 },
    { "America/Fort_Nelson",               79,  -420 },
    { "America/Fort_Wayne",                67,  -240 },
    { "America/Fortaleza",                 30,  -180 },
    { "America/Glace_Bay",                 50,  -180 },
    { "America/Godthab",                   29,   -60 },
    { "America/Goose_Bay",                 50,  -180 },
    { "America/Grand_Turk",                67,  -240 },
    { "America/Grenada",                   49,  -240 },
    { "America/Guadeloupe",                49,  -240 },
    { "America/Guatemala",                 57,  -360 },
    { "America/Guayaquil",                 34,  -300 },
    { "America/Guyana",                    32,  -240 },
    { "America/Halifax",                   50,  -180 },
    { "America/Havana",                    56,  -240 },
    { "America/Hermosillo",                79,  -420 },
    { "America/Indiana/Indianapolis",      67,  -240 },
    { "America/Indiana/Knox",              58,  -300 },
    { "America/Indiana/Marengo",           67,  -240 },
    { "America/Indiana/Petersburg",        67,  -240 },
    { "America/Indiana/Tell_City",         58,  -300 },
    { "America/Indiana/Vevay",             67,  -240 },
    { "America/Indiana/Vincennes",         67,  -240 },
    { "America/Indiana/Winamac",           67,  -240 },
    { "America/Indianapolis",              67,  -240 },
    { "America/Inuvik",                    80,  -360 },
    { "America/Iqaluit",                   67,  -240 },
    { "America/Jamaica",                   66,  -300 },
    { "America/Jujuy",                     30,  -180 },
    { "America/Juneau",                    48,  -480 },
    { "America/Kentucky/Louisville",       67,  -240 },
    { "America/Kentucky/Monticello",       67,  -240 },
    { "America/Knox_IN",                   58,  -300 },
    { "America/Kralendijk",                49,  -240 },
    { "America/La_Paz",                    32,  -240 },
    { "America/Lima",                      34,  -300 },
    { "America/Los_Angeles",               85,  -420 },
    { "America/Louisville",                67,  -240 },
    { "America/Lower_Princes",             49,  -240 },
    { "America/Maceio",                    30,  -180 },
    { "America/Managua",                   57,  -360 },
    { "America/Manaus",                    32,  -240 },
    { "America/Marigot",                   49,  -240 },
    { "America/Martinique",                49,  -240 },
    { "America/Matamoros",                 58,  -300 },
    { "America/Mazatlan",                  79,  -420 },
    { "America/Mendoza",                   30,  -180 },
    { "America/Menominee",                 58,  -300 },
    { "America/Merida",                    57,  -360 },
    { "America/Metlakatla",                48,  -480 },
    { "America/Mexico_City",               57,  -360 },
    { "America/Miquelon",                  31,  -120 },
    { "America/Moncton",                   50,  -180 },
    { "America/Monterrey",                 57,  -360 },
    { "America/Montevideo",                30,  -180 },
    { "America/Montreal",                  67,  -240 },
    { "America/Montserrat",                49,  -240 },
    { "America/Nassau",                    67,  -240 },
    { "America/New_York",                  67,  -240 },
    { "America/Nipigon",                   67,  -240 },
    { "America/Nome",                      48,  -480 },
    { "America/Noronha",                   28,  -120 },
    { "America/North_Dakota/Beulah",       58,  -300 },
    { "America/North_Dakota/Center",       58,  -300 },
    { "America/North_Dakota/New_Salem",    58,  -300 },
    { "America/Nuuk",                      29,   -60 },
    { "America/Ojinaga",                   58,  -300 },
    { "America/Panama",                    66,  -300 },
    { "America/Pangnirtung",               67,  -240 },
    { "America/Paramaribo",                30,  -180 },
    { "America/Phoenix",                   79,  -420 },
    { "America/Port-au-Prince",            67,  -240 },
    { "America/Port_of_Spain",             49,  -240 },
    { "America/Porto_Acre",                34,  -300 },
    { "America/Porto_Velho",               32,  -240 },
    { "America/Puerto_Rico",               49,  -240 },
    { "America/Punta_Arenas",              30,  -180 },
    { "America/Rainy_River",               58,  -300 },
    { "America/Rankin_Inlet",              58,  -300 },
    { "America/Recife",                    30,  -180 },
    { "America/Regina",                    57,  -360 },
    { "America/Resolute",                  58,  -300 },
    { "America/Rio_Branco",                34,  -300 },
    { "America/Rosario",                   30,  -180 },
    { "America/Santa_Isabel",              85,  -420 },
    { "America/Santarem",                  30,  -180 },
    { "America/Santiago",                  33,  -180 },
    { "America/Santo_Domingo",             49,  -240 },
    { "America/Sao_Paulo",                 30,  -180 },
    { "America/Scoresbysund",              29,   -60 },
    { "America/Shiprock",                  80,  -360 },
    { "America/Sitka",                     48,  -480 },
    { "America/St_Barthelemy",             49,  -240 },
    { "America/St_Johns",                  81,  -150 },
    { "America/St_Kitts",                  49,  -240 },
    { "America/St_Lucia",                  49,  -240 },
    { "America/St_Thomas",                 49,  -240 },
    { "America/St_Vincent",                49,  -240 },
    { "America/Swift_Current",             57,  -360 },
    { "America/Tegucigalpa",               57,  -360 },
    { "America/Thule",                     50,  -180 },
    { "America/Thunder_Bay",               67,  -240 },
    { "America/Tijuana",                   85,  -420 },
    { "America/Toronto",                   67,  -240 },
    { "America/Tortola",                   49,  -240 },
    { "America/Vancouver",                 79,  -420 },
    { "America/Virgin",                    49,  -240 },
    { "America/Whitehorse",                79,  -420 },
    { "America/Winnipeg",                  58,  -300 },
    { "America/Yakutat",                   48,  -480 },
    { "America/Yellowknife",               57,  -360 },
    { "Antarctica/Casey",                  15,   480 },
    { "Antarctica/Davis",                  13,   420 },
    { "Antarctica/DumontDUrville",         18,   600 },
    { "Antarctica/Macquarie",              47,   600 },
    { "Antarctica/Mawson",                 10,   300 },
    { "Antarctica/McMurdo",                82,   780 },
    { "Antarctica/Palmer",                 30,  -180 },
    { "Antarctica/Rothera",                30,  -180 },
    { "Antarctica/South_Pole",             82,   780 },
    { "Antarctica/Syowa",                   5,   180 },
    { "Antarctica/Troll",                   1,   120 },
    { "Antarctica/Vostok",                 10,   300 },
    { "Arctic/Longyearbyen",               54,   120 },
    { "Asia/Aden",                          5,   180 },
    { "Asia/Almaty",                       10,   300 },
    { "Asia/Amman",                         5,   180 },
    { "Asia/Anadyr",                       22,   720 },
    { "Asia/Aqtau",                        10,   300 },
    { "Asia/Aqtobe",                       10,   300 },
    { "Asia/Ashgabat",                     10,   300 },
    { "Asia/Ashkhabad",                    10,   300 },
    { "Asia/Atyrau",                       10,   300 },
    { "Asia/Baghdad",                       5,   180 },
    { "Asia/Bahrain",                       5,   180 },
    { "Asia/Baku",                          7,   240 },
    { "Asia/Bangkok",                      13,   420 },
    { "Asia/Barnaul",                      13,   420 },
    { "Asia/Beirut",                       63,   180 },
    { "Asia/Bishkek",                      12,   360 },
    { "Asia/Brunei",                       15,   480 },
    { "Asia/Calcutta",                     75,   330 },
    { "Asia/Chita",                        16,   540 },
    { "Asia/Choibalsan",                   15,   480 },
    { "Asia/Chongqing",                    55,   480 },
    { "Asia/Chungking",                    55,   480 },
    { "Asia/Colombo",                       8,   330 },
    { "Asia/Dacca",                        12,   360 },
    { "Asia/Damascus",                      5,   180 },
    { "Asia/Dhaka",                        12,   360 },
    { "Asia/Dili",                         16,   540 },
    { "Asia/Dubai",                         7,   240 },
    { "Asia/Dushanbe",                     10,   300 },
    { "Asia/Famagusta",                    64,   180 },
    { "Asia/Gaza",                         62,   180 },
    { "Asia/Harbin",                       55,   480 },
    { "Asia/Hebron",                       62,   180 },
    { "Asia/Ho_Chi_Minh",                  13,   420 },
    { "Asia/Hong_Kong",                    70,   480 },
    { "Asia/Hovd",                         13,   420 },
    { "Asia/Irkutsk",                      15,   480 },
    { "Asia/Istanbul",                      5,   180 },
    { "Asia/Jakarta",                      91,   420 },
    { "Asia/Jayapura",                     92,   540 },
    { "Asia/Jerusalem",                    74,   180 },
    { "Asia/Kabul",                         6,   270 },
    { "Asia/Kamchatka",                    22,   720 },
    { "Asia/Karachi",                      83,   300 },
    { "Asia/Kashgar",                      12,   360 },
    { "Asia/Kathmandu",                     9,   345 },
    { "Asia/Katmandu",                      9,   345 },
    { "Asia/Khandyga",                     16,   540 },
    { "Asia/Kolkata",                      75,   330 },
    { "Asia/Krasnoyarsk",                  13,   420 },
    { "Asia/Kuala_Lumpur",                 15,   480 },
    { "Asia/Kuching",                      15,   480 },
    { "Asia/Kuwait",                        5,   180 },
    { "Asia/Macao",                        55,   480 },
    { "Asia/Macau",                        55,   480 },
    { "Asia/Magadan",                      19,   660 },
    { "Asia/Makassar",                     93,   480 },
    { "Asia/Manila",                       84,   480 },
    { "Asia/Muscat",                        7,   240 },
    { "Asia/Nicosia",                      64,   180 },
    { "Asia/Novokuznetsk",                 13,   420 },
    { "Asia/Novosibirsk",                  13,   420 },
    { "Asia/Omsk",                         12,   360 },
    { "Asia/Oral",                         10,   300 },
    { "Asia/Phnom_Penh",                   13,   420 },
    { "Asia/Pontianak",                    91,   420 },
    { "Asia/Pyongyang",                    77,   540 },
    { "Asia/Qatar",                         5,   180 },
    { "Asia/Qostanay",                     10,   300 },
    { "Asia/Qyzylorda",                    10,   300 },
    { "Asia/Rangoon",                      11,   390 },
    { "Asia/Riyadh",                        5,   180 },
    { "Asia/Saigon",                       13,   420 },
    { "Asia/Sakhalin",                     19,   660 },
    { "Asia/Samarkand",                    10,   300 },
    { "Asia/Seoul",                        77,   540 },
    { "Asia/Shanghai",                     55,   480 },
    { "Asia/Singapore",                    15,   480 },
    { "Asia/Srednekolymsk",                19,   660 },
    { "Asia/Taipei",                       55,   480 },
    { "Asia/Tashkent",                     10,   300 },
    { "Asia/Tbilisi",                       7,   240 },
    { "Asia/Tehran",                        4,   210 },
    { "Asia/Tel_Aviv",                     74,   180 },
    { "Asia/Thimbu",                       12,   360 },
    { "Asia/Thimphu",                      12,   360 },
    { "Asia/Tokyo",                        76,   540 },
    { "Asia/Tomsk",                        13,   420 },
    { "Asia/Ujung_Pandang",                93,   480 },
    { "Asia/Ulaanbaatar",                  15,   480 },
    { "Asia/Ulan_Bator",                   15,   480 },
    { "Asia/Urumqi",                       12,   360 },
    { "Asia/Ust-Nera",                     18,   600 },
    { "Asia/Vientiane",                    13,   420 },
    { "Asia/Vladivostok",                  18,   600 },
    { "Asia/Yakutsk",                      16,   540 },
    { "Asia/Yangon",                       11,   390 },
    { "Asia/Yekaterinburg",                10,   300 },
    { "Asia/Yerevan",                       7,   240 },
    { "Atlantic/Azores",                   27,     0 },
    { "Atlantic/Bermuda",                  50,  -180 },
    { "Atlantic/Canary",                   90,    60 },
    { "Atlantic/Cape_Verde",               26,   -60 },
    { "Atlantic/Faeroe",                   90,    60 },
    { "Atlantic/Faroe",                    90,    60 },
    { "Atlantic/Jan_Mayen",                54,   120 },
    { "Atlantic/Madeira",                  90,    60 },
    { "Atlantic/Reykjavik",                68,     0 },
    { "Atlantic/South_Georgia",            28,  -120 },
    { "Atlantic/St_Helena",                68,     0 },
    { "Atlantic/Stanley",                  30,  -180 },
    { "Australia/ACT",                     47,   600 },
    { "Australia/Adelaide",                45,   570 },
    { "Australia/Brisbane",                46,   600 },
    { "Australia/Broken_Hill",             45,   570 },
    { "Australia/Canberra",                47,   600 },
    { "Australia/Currie",                  47,   600 },
    { "Australia/Darwin",                  44,   570 },
    { "Australia/Eucla",                   14,   525 },
    { "Australia/Hobart",                  47,   600 },
    { "Australia/LHI",                     17,   630 },
    { "Australia/Lindeman",                46,   600 },
    { "Australia/Lord_Howe",               17,   630 },
    { "Australia/Melbourne",               47,   600 },
    { "Australia/NSW",                     47,   600 },
    { "Australia/North",                   44,   570 },
    { "Australia/Perth",                   51,   480 },
    { "Australia/Queensland",              46,   600 },
    { "Australia/South",                   45,   570 },
    { "Australia/Sydney",                  47,   600 },
    { "Australia/Tasmania",                47,   600 },
    { "Australia/Victoria",                47,   600 },
    { "Australia/West",                    51,   480 },
    { "Australia/Yancowinna",              45,   570 },
    { "Brazil/Acre",                       34,  -300 },
    { "Brazil/DeNoronha",                  28,  -120 },
    { "Brazil/East",                       30,  -180 },
    { "Brazil/West",                       32,  -240 },
    { "CET",                               54,   120 },
    { "CST6CDT",                           58,  -300 },
    { "Canada/Atlantic",                   50,  -180 },
    { "Canada/Central",                    58,  -300 },
    { "Canada/Eastern",                    67,  -240 },
    { "Canada/Mountain",                   57,  -360 },
    { "Canada/Newfoundland",               81,  -150 },
    { "Canada/Pacific",                    79,  -420 },
    { "Canada/Saskatchewan",               57,  -360 },
    { "Canada/Yukon",                      79,  -420 },
    { "Chile/Continental",                 33,  -180 },
    { "Chile/EasterIsland",                36,  -300 },
    { "Cuba",                              56,  -240 },
    { "EET",                               64,   180 },
    { "EST",                               66,  -300 },
    { "EST5EDT",                           67,  -240 },
    { "Egypt",                             65,   120 },
    { "Eire",                              73,    60 },
    { "Etc/GMT",                           68,     0 },
    { "Etc/GMT+0",                         68,     0 },
    { "Etc/GMT+1",                         26,   -60 },
    { "Etc/GMT+10",                        41,  -600 },
    { "Etc/GMT+11",                        42,  -660 },
    { "Etc/GMT+12",                        43,  -720 },
    { "Etc/GMT+2",                         28,  -120 },
    { "Etc/GMT+3",                         30,  -180 },
    { "Etc/GMT+4",                         32,  -240 },
    { "Etc/GMT+5",                         34,  -300 },
    { "Etc/GMT+6",                         35,  -360 },
    { "Etc/GMT+7",                         37,  -420 },
    { "Etc/GMT+8",                         38,  -480 },
    { "Etc/GMT+9",                         40,  -540 },
    { "Etc/GMT-0",                         68,     0 },
    { "Etc/GMT-1",                          2,    60 },
    { "Etc/GMT-10",                        18,   600 },
    { "Etc/GMT-11",                        19,   660 },
    { "Etc/GMT-12",                        22,   720 },
    { "Etc/GMT-13",                        23,   780 },
    { "Etc/GMT-14",                        24,   840 },
    { "Etc/GMT-2",                          3,   120 },
    { "Etc/GMT-3",                          5,   180 },
    { "Etc/GMT-4",                          7,   240 },
    { "Etc/GMT-5",                         10,   300 },
    { "Etc/GMT-6",                         12,   360 },
    { "Etc/GMT-7",                         13,   420 },
    { "Etc/GMT-8",                         15,   480 },
    { "Etc/GMT-9",                         16,   540 },
    { "Etc/GMT0",                          68,     0 },
    { "Etc/Greenwich",                     68,     0 },
    { "Etc/UCT",                           88,     0 },
    { "Etc/UTC",                           88,     0 },
    { "Etc/Universal",                     88,     0 },
    { "Etc/Zulu",                          88,     0 },
    { "Europe/Amsterdam",                  54,   120 },
    { "Europe/Andorra",                    54,   120 },
    { "Europe/Astrakhan",                   7,   240 },
    { "Europe/Athens",                     64,   180 },
    { "Europe/Belfast",                    69,    60 },
    { "Europe/Belgrade",                   54,   120 },
    { "Europe/Berlin",                     54,   120 },
    { "Europe/Bratislava",                 54,   120 },
    { "Europe/Brussels",                   54,   120 },
    { "Europe/Bucharest",                  64,   180 },
    { "Europe/Budapest",                   54,   120 },
    { "Europe/Busingen",                   54,   120 },
    { "Europe/Chisinau",                   64,   180 },
    { "Europe/Copenhagen",                 54,   120 },
    { "Europe/Dublin",                     73,    60 },
    { "Europe/Gibraltar",                  54,   120 },
    { "Europe/Guernsey",                   69,    60 },
    { "Europe/Helsinki",                   64,   180 },
    { "Europe/Isle_of_Man",                69,    60 },
    { "Europe/Istanbul",                    5,   180 },
    { "Europe/Jersey",                     69,    60 },
    { "Europe/Kaliningrad",                61,   120 },
    { "Europe/Kiev",                       64,   180 },
    { "Europe/Kirov",                      78,   180 },
    { "Europe/Kyiv",                       64,   180 },
    { "Europe/Lisbon",                     90,    60 },
    { "Europe/Ljubljana",                  54,   120 },
    { "Europe/London",                     69,    60 },
    { "Europe/Luxembourg",                 54,   120 },
    { "Europe/Madrid",                     54,   120 },
    { "Europe/Malta",                      54,   120 },
    { "Europe/Mariehamn",                  64,   180 },
    { "Europe/Minsk",                       5,   180 },
    { "Europe/Monaco",                     54,   120 },
    { "Europe/Moscow",                     78,   180 },
    { "Europe/Nicosia",                    64,   180 },
    { "Europe/Oslo",                       54,   120 },
    { "Europe/Paris",                      54,   120 },
    { "Europe/Podgorica",                  54,   120 },
    { "Europe/Prague",                     54,   120 },
    { "Europe/Riga",                       64,   180 },
    { "Europe/Rome",                       54,   120 },
    { "Europe/Samara",                      7,   240 },
    { "Europe/San_Marino",                 54,   120 },
    { "Europe/Sarajevo",                   54,   120 },
    { "Europe/Saratov",                     7,   240 },
    { "Europe/Simferopol",                 78,   180 },
    { "Europe/Skopje",                     54,   120 },
    { "Europe/Sofia",                      64,   180 },
    { "Europe/Stockholm",                  54,   120 },
    { "Europe/Tallinn",                    64,   180 },
    { "Europe/Tirane",                     54,   120 },
    { "Europe/Tiraspol",                   64,   180 },
    { "Europe/Ulyanovsk",                   7,   240 },
    { "Europe/Uzhgorod",                   64,   180 },
    { "Europe/Vaduz",                      54,   120 },
    { "Europe/Vatican",                    54,   120 },
    { "Europe/Vienna",                     54,   120 },
    { "Europe/Vilnius",                    64,   180 },
    { "Europe/Volgograd",                  78,   180 },
    { "Europe/Warsaw",                     54,   120 },
    { "Europe/Zagreb",                     54,   120 },
    { "Europe/Zaporozhye",                 64,   180 },
    { "Europe/Zurich",                     54,   120 },
    { "Factory",                           25,     0 },
    { "GB",                                69,    60 },
    { "GB-Eire",                           69,    60 },
    { "GMT",                               68,     0 },
    { "GMT+0",                             68,     0 },
    { "GMT-0",                             68,     0 },
    { "GMT0",                              68,     0 },
    { "Greenwich",                         68,     0 },
    { "HST",                               71,  -600 },
    { "Hongkong",                          70,   480 },
    { "Iceland",                           68,     0 },
    { "Indian/Antananarivo",               60,   180 },
    { "Indian/Chagos",                     12,   360 },
    { "Indian/Christmas",                  13,   420 },
    { "Indian/Cocos",                      11,   390 },
    { "Indian/Comoro",                     60,   180 },
    { "Indian/Kerguelen",                  10,   300 },
    { "Indian/Mahe",                        7,   240 },
    { "Indian/Maldives",                   10,   300 },
    { "Indian/Mauritius",                   7,   240 },
    { "Indian/Mayotte",                    60,   180 },
    { "Indian/Reunion",                     7,   240 },
    { "Iran",                               4,   210 },
    { "Israel",                            74,   180 },
    { "Jamaica",                           66,  -300 },
    { "Japan",                             76,   540 },
    { "Kwajalein",                         22,   720 },
    { "Libya",                             61,   120 },
    { "MET",                               54,   120 },
    { "MST",                               79,  -420 },
    { "MST7MDT",                           80,  -360 },
    { "Mexico/BajaNorte",                  85,  -420 },
    { "Mexico/BajaSur",                    79,  -420 },
    { "Mexico/General",                    57,  -360 },
    { "NZ",                                82,   780 },
    { "NZ-CHAT",                           21,   825 },
    { "Navajo",                            80,  -360 },
    { "PRC",                               55,   480 },
    { "PST8PDT",                           85,  -420 },
    { "Pacific/Apia",                      23,   780 },
    { "Pacific/Auckland",                  82,   780 },
    { "Pacific/Bougainville",              19,   660 },
    { "Pacific/Chatham",                   21,   825 },
    { "Pacific/Chuuk",                     18,   600 },
    { "Pacific/Easter",                    36,  -300 },
    { "Pacific/Efate",                     19,   660 },
    { "Pacific/Enderbury",                 23,   780 },
    { "Pacific/Fakaofo",                   23,   780 },
    { "Pacific/Fiji",                      22,   720 },
    { "Pacific/Funafuti",                  22,   720 },
    { "Pacific/Galapagos",                 35,  -360 },
    { "Pacific/Gambier",                   40,  -540 },
    { "Pacific/Guadalcanal",               19,   660 },
    { "Pacific/Guam",                      59,   600 },
    { "Pacific/Honolulu",                  71,  -600 },
    { "Pacific/Johnston",                  71,  -600 },
    { "Pacific/Kanton",                    23,   780 },
    { "Pacific/Kiritimati",                24,   840 },
    { "Pacific/Kosrae",                    19,   660 },
    { "Pacific/Kwajalein",                 22,   720 },
    { "Pacific/Majuro",                    22,   720 },
    { "Pacific/Marquesas",                 39,  -570 },
    { "Pacific/Midway",                    87,  -660 },
    { "Pacific/Nauru",                     22,   720 },
    { "Pacific/Niue",                      42,  -660 },
    { "Pacific/Norfolk",                   20,   660 },
    { "Pacific/Noumea",                    19,   660 },
    { "Pacific/Pago_Pago",                 87,  -660 },
    { "Pacific/Palau",                     16,   540 },
    { "Pacific/Pitcairn",                  38,  -480 },
    { "Pacific/Pohnpei",                   19,   660 },
    { "Pacific/Ponape",                    19,   660 },
    { "Pacific/Port_Moresby",              18,   600 },
    { "Pacific/Rarotonga",                 41,  -600 },
    { "Pacific/Saipan",                    59,   600 },
    { "Pacific/Samoa",                     87,  -660 },
    { "Pacific/Tahiti",                    41,  -600 },
    { "Pacific/Tarawa",                    22,   720 },
    { "Pacific/Tongatapu",                 23,   780 },
    { "Pacific/Truk",                      18,   600 },
    { "Pacific/Wake",                      22,   720 },
    { "Pacific/Wallis",                    22,   720 },
    { "Pacific/Yap",                       18,   600 },
    { "Poland",                            54,   120 },
    { "Portugal",                          90,    60 },
    { "ROC",                               55,   480 },
    { "ROK",                               77,   540 },
    { "Singapore",                         15,   480 },
    { "Turkey",                             5,   180 },
    { "UCT",                               88,     0 },
    { "US/Alaska",                         48,  -480 },
    { "US/Aleutian",                       72,  -540 },
    { "US/Arizona",                        79,  -420 },
    { "US/Central",                        58,  -300 },
    { "US/East-Indiana",                   67,  -240 },
    { "US/Eastern",                        67,  -240 },
    { "US/Hawaii",                         71,  -600 },
    { "US/Indiana-Starke",                 58,  -300 },
    { "US/Michigan",                       67,  -240 },
    { "US/Mountain",                       80,  -360 },
    { "US/Pacific",                        85,  -420 },
    { "US/Samoa",                          87,  -660 },
    { "UTC",                               88,     0 },
    { "Universal",                         88,     0 },
    { "W-SU",                              78,   180 },
    { "WET",                               90,    60 },
    { "Zulu",                              88,     0 },
};
