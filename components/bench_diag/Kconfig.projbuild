## components/bench_diag/Kconfig.projbuild
```kconfig
menu "Ambyte bench diagnostics"

config AMBYTE_BENCH_DIAG
    bool "Enable root-cause bench diagnostics"
    default n
    help
        Starts a low-priority task which reports heap-capability, lwIP socket,
        lwIP protocol, and Wi-Fi buffer diagnostics once per minute. This is a
        bench-only facility and is disabled in production builds.

config AMBYTE_BENCH_WIFI_PS_NONE
    bool "Force Wi-Fi power save off for the bench"
    depends on AMBYTE_BENCH_DIAG
    default n
    help
        After Wi-Fi has started, override the production WIFI_PS_MIN_MODEM mode
        with WIFI_PS_NONE. Use only for the Wi-Fi power-save bisect run.

endmenu
```

## components/evq_hil/Kconfig.projbuild
```kconfig
menu "Ambyte SD overflow on-device verification"

config AMBYTE_EVQ_HIL
    bool "Enable the evq_hil hardware-in-the-loop verification controls"
    default n
    help
        Test-only build (PlatformIO env evq-hil): synthetic record fill through
        the production store path, read-only flash/SD/index inventories, an
        RTC-retained SD boot hold and publish-gate hold, named fault injection
        and an I/O trace in event_log. See docs/evq-sd-overflow-hil-contract.md.
        Never enabled in a release image.

endmenu
```

## components/sensor_inventory/Kconfig.projbuild
```kconfig
menu "Sensor inventory qualification"
    config AMBYTE_SENSOR_RECOVERY_HIL
        bool "Enable bench-only acquisition recovery trigger"
        default n
        help
            Adds sensors_recovery_hil for physical qualification of the same
            recovery block while idle or acquiring. Never enable in release.
endmenu
```

## components/usb_service/Kconfig.projbuild
```kconfig
menu "Ambyte USB service benchmark"

config AMBYTE_SVC_BENCH
    bool "Enable the volatile USB checksum-sink benchmark"
    default n
    help
        Bench-only transport measurements (PlatformIO env svc-bench). Enables
        volatile ingress and egress up to 1 MiB without storing payloads or
        touching capture, SD, firmware or credentials. Never ship in a release.

endmenu
```
