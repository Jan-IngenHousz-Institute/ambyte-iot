/* Scripted driver for the AMBIT SD writers under host test (tests/ambit_host).
 * HEAD: production components/ambit_ota/ambit_stage.c and
 * components/ambit_flash/ambit_flash_preflight.c; the ambit_flash_image prefix
 * (up to taking the UART bus) is sliced verbatim from the source of the SAME
 * revision (slice_flash.c, generated by ambit_lib.py). BASE (-DAMBIT_BASE): the
 * rev's http_get_to_file_impl and ambit_flash_image prefix, sliced verbatim. */
#include <stdbool.h>
#include <stdint.h>
#include <stdio.h>
#include <stdlib.h>
#include <string.h>
#include <unistd.h>

#include "esp_err.h"
#include "mbedtls/sha256.h"
#include "sd_card.h"
#include "sd_diag.h"
#include "sd_shim.h"
#ifndef AMBIT_BASE
#include "ambit_stage.h"
#endif

#undef fopen
#undef fclose
#undef fwrite
#undef fread
#undef fflush
#undef fsync
#undef ftruncate
#undef fseek
#undef ftell
#undef fgetc
#undef rename
#undef remove
#undef mkdir
#undef stat
#undef opendir
#undef time

/* ── image source ── */
size_t   g_src_len;
size_t   g_src_pos;
int64_t  g_src_clen;
int      g_src_fail_at = -1;      /* network read error after this many bytes */
uint8_t  g_src_seed;
static uint8_t src_byte(size_t i) { return (uint8_t)((i * 131u + 7u) ^ g_src_seed); }

int src_read(void *ctx, uint8_t *buf, size_t cap)
{
    (void)ctx;
    if (g_src_fail_at >= 0 && g_src_pos >= (size_t)g_src_fail_at) return -1;
    size_t n = g_src_len - g_src_pos;
    if (n > cap) n = cap;
    if (n > 700) n = 700;                 /* uneven chunks */
    for (size_t i = 0; i < n; i++) buf[i] = src_byte(g_src_pos + i);
    g_src_pos += n;
    return (int)n;
}

static void src_sha(char out[65])
{
    mbedtls_sha256_context c;
    mbedtls_sha256_init(&c);
    mbedtls_sha256_starts(&c, 0);
    for (size_t i = 0; i < g_src_len; i++) { uint8_t b = src_byte(i); mbedtls_sha256_update(&c, &b, 1); }
    uint8_t d[32];
    mbedtls_sha256_finish(&c, d);
    for (int i = 0; i < 32; i++) sprintf(out + 2 * i, "%02x", d[i]);
}

/* ── flash-session stub (records whether the target would be touched) ── */
int g_session_called;
esp_err_t uart_sensors_flash_session_begin(uint8_t ch, uint32_t wait_ms)
{
    (void)ch; (void)wait_ms;
    g_session_called++;
    return ESP_FAIL;                       /* stop right there: nothing below is under test */
}
esp_err_t slice_flash_image(uint8_t channel, const char *dir);

#ifdef AMBIT_BASE
esp_err_t base_http_get_to_file(const char *url, const char *path, size_t *out_size);
#else
static ambit_stage_t s_stage;
static int s_sink_begin, s_sink_end, s_sink_abort;
static size_t s_sink_bytes;
static bool sb(void *c, size_t len) { (void)c; (void)len; s_sink_begin++; return true; }
static bool sd(void *c, const uint8_t *b, size_t n) { (void)c; (void)b; s_sink_bytes += n; return true; }
static bool se(void *c) { (void)c; s_sink_end++; return true; }
static void sa(void *c) { (void)c; s_sink_abort++; }
#endif

/* teardown-at-boundary hook */
static char s_td_op[16];
static unsigned s_td_nth, s_td_hits;
static void td_hook(const char *op, const char *path)
{
    (void)path;
    if (s_td_op[0] && strcmp(op, s_td_op) == 0 && ++s_td_hits == s_td_nth) g_sd_teardown = 1;
}

int main(int argc, char **argv)
{
    if (argc < 2 || chdir(argv[1]) != 0) { fprintf(stderr, "usage: ambit_driver <state-dir>\n"); return 2; }
    mkdir("sdcard", 0777);
    shim_open_log("ops.jsonl");
    g_shim_before_op = td_hook;
    char line[512];
    while (fgets(line, sizeof line, stdin)) {
        char cmd[32] = "";
        sscanf(line, "%31s", cmd);
        if (strcmp(cmd, "source") == 0) {
            unsigned long len = 0; long long clen = -1; int fail = -1; unsigned seed = 0;
            sscanf(line, "%*s %lu %lld %d %u", &len, &clen, &fail, &seed);
            g_src_len = len; g_src_clen = clen < 0 ? (int64_t)len : clen; g_src_fail_at = fail; g_src_seed = (uint8_t)seed;
            g_src_pos = 0;
            char h[65];
            src_sha(h);
            printf("{\"source_sha\":\"%s\",\"len\":%lu}\n", h, len);
        } else if (strcmp(cmd, "download") == 0) {
            g_src_pos = 0;
            if (!sdcard_io_begin()) { printf("{\"download\":\"gate_refused\"}\n"); fflush(stdout); continue; }
#ifdef AMBIT_BASE
            size_t sz = 0;
            esp_err_t rc = base_http_get_to_file("http://x/img", "./sdcard/ambit_fw.bin", &sz);
            printf("{\"rc\":%d,\"size\":%zu}\n", rc, sz);
#else
            ambit_stage_why_t why;
            ambit_stage_cleanup_t cl;
            esp_err_t rc = ambit_stage_download("./sdcard", src_read, NULL, g_src_clen, &s_stage, &why, &cl);
            char h[65] = "";
            for (int i = 0; i < 32; i++) sprintf(h + 2 * i, "%02x", s_stage.sha256[i]);
            printf("{\"rc\":%d,\"why\":\"%s\",\"path\":\"%s\",\"len\":%zu,\"sha\":\"%s\",\"stale_removed\":%u,"
                   "\"stale_remove_err\":%u}\n", rc, ambit_stage_why_name(why), s_stage.path, s_stage.len, h,
                   cl.stale_removed, cl.stale_remove_err);
#endif
            sdcard_io_end();
        } else if (strcmp(cmd, "stream") == 0) {
#ifndef AMBIT_BASE
            s_sink_begin = s_sink_end = s_sink_abort = 0; s_sink_bytes = 0;
            const ambit_stage_sink_t sink = { .ctx = NULL, .begin = sb, .data = sd, .end = se, .abort = sa };
            uint8_t buf[200];
            sdcard_io_begin();
            bool ok = ambit_stage_stream(&s_stage, &sink, buf, sizeof buf);
            sdcard_io_end();
            printf("{\"stream\":%d,\"begin\":%d,\"end\":%d,\"abort\":%d,\"bytes\":%zu}\n", ok, s_sink_begin, s_sink_end,
                   s_sink_abort, s_sink_bytes);
#else
            printf("{\"stream\":\"n/a\"}\n");
#endif
        } else if (strcmp(cmd, "remove_stage") == 0) {
#ifndef AMBIT_BASE
            sdcard_io_begin();
            bool ok = ambit_stage_remove(&s_stage);
            sdcard_io_end();
            printf("{\"removed\":%d}\n", ok);
#endif
        } else if (strcmp(cmd, "flash_image") == 0) {
            char dir[160] = "";
            sscanf(line, "%*s %159s", dir);
            g_session_called = 0;
            esp_err_t rc = slice_flash_image(0, dir);
            printf("{\"rc\":%d,\"session\":%d,\"refs\":%d}\n", rc, g_session_called, g_sd_refs);
        } else if (strcmp(cmd, "teardown_at") == 0) {
            sscanf(line, "%*s %15s %u", s_td_op, &s_td_nth);
            s_td_hits = 0;
        } else if (strcmp(cmd, "teardown_now") == 0) {
            g_sd_teardown = 1;
        } else if (strcmp(cmd, "arm") == 0) {
            char op[32], mode[32], sub[128] = "";
            unsigned nth = 1, count = 1;
            int k = sscanf(line, "%*s %31s %31s %u %u %127s", op, mode, &nth, &count, sub);
            shim_mode_t m;
            int ok = k >= 2 && shim_parse_mode(mode, &m) == 0 && shim_arm(op, k >= 5 ? sub : NULL, m, nth, count) == 0;
            printf("{\"arm\":\"%s\"}\n", ok ? "ok" : "bad");
        } else if (strcmp(cmd, "status") == 0) {
            sd_diag_block_t db;
            sd_diag_get(&db);
            char dj[2048] = "{}";
            sd_diag_render_json(&db, dj, sizeof dj);
            printf("{\"violations\":%u,\"refs\":%d,\"io_errors\":%u,\"diag\":%s}\n", shim_violations(), g_sd_refs,
                   g_sd_io_errors, dj);
        } else if (strcmp(cmd, "quit") == 0) {
            break;
        } else if (cmd[0]) {
            printf("{\"error\":\"unknown %s\"}\n", cmd);
        }
        fflush(stdout);
    }
    return 0;
}
