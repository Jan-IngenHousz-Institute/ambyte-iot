## sdkconfig.defaults
```kconfig
CONFIG_AMBYTE_WIFI_SSID="__UNPROVISIONED__"
CONFIG_AMBYTE_WIFI_PASSWORD="__UNPROVISIONED__"
# CONFIG_ESP_CONSOLE_UART_DEFAULT is not set
CONFIG_ESP_CONSOLE_USB_SERIAL_JTAG=y
CONFIG_ESP_CONSOLE_SECONDARY_NONE=y
# CONFIG_ESP_CONSOLE_SECONDARY_USB_SERIAL_JTAG is not set
CONFIG_ESPTOOLPY_FLASHSIZE_16MB=y
# CONFIG_ESPTOOLPY_FLASHSIZE_4MB is not set
CONFIG_ESPTOOLPY_FLASHSIZE="16MB"
CONFIG_ESPTOOLPY_FLASHSIZE_DETECT=y
CONFIG_PARTITION_TABLE_CUSTOM=y
CONFIG_PARTITION_TABLE_CUSTOM_FILENAME="partitions.csv"
# CONFIG_PARTITION_TABLE_SINGLE_APP is not set
# OTA Stage 1: dual-OTA partition table (ota_0/ota_1/otadata) needs rollback so a
# bad self-OTA image (booted PENDING_VERIFY) reverts unless the new app calls
# esp_ota_mark_app_valid_cancel_rollback() — wired in Stage 3, gated on MQTT
# reconnect. Harmless for esptool-flashed apps (they boot VALID, never roll back).
CONFIG_BOOTLOADER_APP_ROLLBACK_ENABLE=y
CONFIG_MQTT_PROTOCOL_5=y
# CONFIG_MQTT_PROTOCOL_311 is not set
CONFIG_ESP_TASK_WDT_PANIC=y
CONFIG_ESP_COREDUMP_ENABLE_TO_FLASH=y
CONFIG_HEAP_POISONING_LIGHT=y
CONFIG_COMPILER_STACK_CHECK_MODE_NORM=y
CONFIG_ESP_MAIN_TASK_STACK_SIZE=16384
# The system event task (sys_evt) runs the Wi-Fi/IP event handlers, including the
# app's on_wifi_disconnect -> mqtt_client_stop and the mbedTLS teardown. The
# default 2304 B overflows when a disconnect (or an esp_restart) races an active
# TLS transfer — observed as a sys_evt stack overflow when the connectivity
# watchdog rebooted mid-drain. Raise it so teardown always has headroom (also
# hardens the CLI `reboot` and any real field Wi-Fi drop during a publish).
# NOTE: editing this file alone does NOT re-apply — the per-env generated
# sdkconfig.esp32-s3-devkitm-1 is set to match; delete it to regenerate.
CONFIG_ESP_SYSTEM_EVENT_TASK_STACK_SIZE=6144
# Provisioning is delivered via host-side NVS pre-population (tools/extra_script.py),
# so the Bluetooth stack is left out of the build entirely.
# CONFIG_BT_ENABLED is not set
# FAT long filename support (required for SQLite DB file)
# CONFIG_FATFS_LFN_NONE is not set
CONFIG_FATFS_LFN_HEAP=y
CONFIG_FATFS_MAX_LFN=255
# TLS inbound record buffer max. Was lowered to 8 KiB to let MQTT reconnect on a
# fragmented heap (a 16 KiB contiguous block was unobtainable mid-run -> mbedtls
# ALLOC_FAILED). RESTORED to 16 KiB for OTA: S3/Fastly (GitHub release CDN) stream
# the firmware body in full-size 16 KiB TLS records, and with DYNAMIC_BUFFER on, an
# incoming record larger than this cap fails with -0x7100 (BAD_INPUT_DATA) on the
# first data read. Safe to raise BECAUSE DYNAMIC_BUFFER makes this a *transient
# per-record ceiling*, not a buffer held for the connection's life: MQTT's small
# records still alloc small, only OTA's large records use the 16 KiB headroom. OUT
# is separate (asymmetric content len is enabled). Watch the sync_runner "heap:"
# line after this change to confirm steady-state MQTT is unaffected.
CONFIG_MBEDTLS_SSL_IN_CONTENT_LEN=16384
# OUT dropped 4 KiB -> 2 KiB: the per-write TLS buffer is allocated to this size
# with DYNAMIC_BUFFER on, and its ~4.4 KiB alloc was the exact failure that dropped
# MQTT while publishing a large (~5.4 KiB) arrun trace on a fragmented heap. A 2 KiB
# out record just sends a big payload in more records (a few extra header bytes,
# negligible) while halving that transient alloc. TX only — inbound/OTA use IN.
CONFIG_MBEDTLS_SSL_OUT_CONTENT_LEN=2048
# Dynamic TLS record buffers: free the 8 KiB IN / 4 KiB OUT record buffers
# *between* records and reallocate per-record sized to need, instead of holding
# all 12 KiB for the connection's lifetime. This is the targeted fix for the OOM
# death-spiral seen under load: an MQTT write stall -> esp-mqtt auto-reconnect
# churned those 12 KiB through an already-fragmented heap until a 3 KiB malloc
# and the Wi-Fi driver (wifi:m f null) starved. We publish one ~3 KiB event every
# few seconds, so we are heap-bound, not throughput-bound — a great trade.
# The further cert/key-free options (FREE_CA_CERT, ~6 KiB) are gated behind
# MBEDTLS_DYNAMIC_FREE_CONFIG_DATA, which frees the client private key after the
# handshake and is flagged in IDF's own help as problematic for reconnects — a
# real risk on our mutual-TLS link. Held back; revisit only if DYNAMIC_BUFFER
# alone doesn't give enough headroom (watch the sync_runner "heap:" line).
CONFIG_MBEDTLS_DYNAMIC_BUFFER=y
# Mozilla CA certificate bundle — lets esp_https_ota validate arbitrary public
# TLS hosts (GitHub + its Fastly CDN across the release/raw 302 redirect) without
# pinning a single cert. Required by the OTA download path (and the Stage-0 spike,
# components/ota_spike). FULL bundle covers the roots GitHub/Fastly chain to.
# Costs ~64 KiB flash; it is in EVERY build once enabled (the firmware is ~1.36 MB
# in a 3 MB partition, so there is ample room).
# NOTE: editing this file alone does NOT re-apply — delete the per-env generated
# sdkconfig (sdkconfig.esp32-s3-devkitm-1) so PlatformIO regenerates it.
CONFIG_MBEDTLS_CERTIFICATE_BUNDLE=y
CONFIG_MBEDTLS_CERTIFICATE_BUNDLE_DEFAULT_FULL=y
# Standalone heap leak tracing — DIAGNOSTIC ONLY. It found the leak (a Lua GC
# starvation: sched.run blocks in C between cycles, starving Lua's alloc-driven
# incremental GC, so measurement result tables piled up ~6 KB/min). Fixed with a
# collectgarbage("collect") per sched.run cycle. Re-enable these two lines (the
# `heaptrace start|stop|dump` CLI command compiles back in via #ifdef) if another
# leak ever needs chasing; off by default to reclaim ~17 KiB static .bss.
# CONFIG_HEAP_TRACING_STANDALONE=y
# CONFIG_HEAP_TRACING_STACK_DEPTH=4
# Phase 2 power management (DFS-only for now): enables esp_pm so app_main can
# esp_pm_configure() dynamic frequency scaling (CPU 80<->160 MHz) during the idle
# gaps and hold a NO_LIGHT_SLEEP pm_lock across AMBIT measurement windows.
# light_sleep is left OFF (set at runtime) until tickless idle + a full
# peripheral-bracket audit. Safe under DFS: the AMBIT UART is pinned to XTAL and
# I2C uses I2C_SCLK_SRC_FLAG_AWARE_DFS.
# NOTE: as with the cert bundle above, editing this file alone does NOT re-apply
# — delete the per-env sdkconfig (sdkconfig.esp32-s3-devkitm-1) to regenerate.
CONFIG_PM_ENABLE=y
# ── PSRAM (2 MB QUAD, module N16R2) ────────────────────────────────────────────
# The production module physically has 2 MB QUAD PSRAM. Enabling it is the
# config-level fix for the internal-DRAM heap fragmentation that stalled large
# MQTT publishes (arrun traces ~3-9 KB) and starved Lua/TLS reconnects on the
# ~24 KB fragmented internal heap. ALWAYSINTERNAL=1024 is the load-bearing knob:
# allocations >1 KB (envelope copy, esp-mqtt outbox copy, mbedTLS cert-flight)
# spill to PSRAM so internal DRAM de-fragments; a higher threshold leaves them
# internal and PSRAM buys nothing. IGNORE_NOTFOUND=y is mandatory for a fleet OTA:
# a unit whose PSRAM fails to enumerate then boots degraded instead of abort()-
# looping (brick). ALLOW_STACK_EXTERNAL off keeps task stacks out of PSRAM — a
# stack torn down in a cache-disabled OTA flash window would panic; inert today
# (IDF 5.5 forces stacks internal) but a foot-gun for future *WithCaps tasks.
# RESERVE_INTERNAL keeps ~32 KB internal for DMA/ISR. Audit: memory/psram-enablement.md.
# NOTE: editing this file alone does NOT re-apply — the per-env generated
# sdkconfig.esp32-s3-devkitm-1 is set to match; delete it to regenerate.
CONFIG_SPIRAM=y
CONFIG_SPIRAM_MODE_QUAD=y
CONFIG_SPIRAM_SPEED_40M=y
CONFIG_SPIRAM_USE_MALLOC=y
CONFIG_SPIRAM_IGNORE_NOTFOUND=y
CONFIG_SPIRAM_MALLOC_ALWAYSINTERNAL=1024
CONFIG_SPIRAM_MALLOC_RESERVE_INTERNAL=32768
CONFIG_SPIRAM_TRY_ALLOCATE_WIFI_LWIP=y
# FREERTOS_TASK_CREATE_ALLOW_EXT_MEM is the current name of the deprecated
# SPIRAM_ALLOW_STACK_EXTERNAL_MEMORY: it only lets xTaskCreateStatic ACCEPT a
# SPIRAM stack. Off (=n) makes the kernel REJECT any SPIRAM stack, so a future
# *WithCaps/static-SPIRAM stack on a flash/OTA-touching task asserts loudly
# instead of silently bricking the next cache-disabled flash write.
CONFIG_FREERTOS_TASK_CREATE_ALLOW_EXT_MEM=n
# mbedTLS uses the default heap (internal-first, spills the big >1 KB handshake/
# cert buffers to PSRAM). NOT INTERNAL (pins TLS to DRAM -> reconnect OOM stays)
# and NOT EXTERNAL (forces every TLS alloc to slower PSRAM).
CONFIG_MBEDTLS_DEFAULT_MEM_ALLOC=y
```
